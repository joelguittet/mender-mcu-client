## zephyr/Kconfig
```kconfig
# @file      Kconfig
# @brief     mender-mcu-client module Kconfig file
#
# Copyright joelguittet and mender-mcu-client contributors
#
# Licensed under the Apache License, Version 2.0 (the "License");
# you may not use this file except in compliance with the License.
# You may obtain a copy of the License at
#
#     http://www.apache.org/licenses/LICENSE-2.0
#
# Unless required by applicable law or agreed to in writing, software
# distributed under the License is distributed on an "AS IS" BASIS,
# WITHOUT WARRANTIES OR CONDITIONS OF ANY KIND, either express or implied.
# See the License for the specific language governing permissions and
# limitations under the License.

menuconfig MENDER_MCU_CLIENT
    bool "Mender Firmware Over-the-Air support"
    select BOOTLOADER_MCUBOOT
    select DNS_RESOLVER
    select FLASH
    select FLASH_MAP
    select HTTP_CLIENT
    select IMG_ENABLE_IMAGE_CHECK
    select IMG_ERASE_PROGRESSIVELY
    select IMG_MANAGER
    select MPU_ALLOW_FLASH_WRITE
    select NETWORKING
    select NET_TCP
    select NET_SOCKETS
    select REBOOT
    select STREAM_FLASH
    select WEBSOCKET_CLIENT if MENDER_CLIENT_ADD_ON_TROUBLESHOOT
    help
        Secure, risk tolerant and efficient over-the-air updates for all device software.

if MENDER_MCU_CLIENT

    menu "General configuration"

        config MENDER_SERVER_HOST
            string "Mender server host URL"
            default "https://hosted.mender.io"
            help
                Set the Mender server host URL to be used on the device.

        config MENDER_SERVER_TENANT_TOKEN
            string "Mender server Tenant Token"
            help
                Set the Mender server Tenant Token, to be used with https://hosted.mender.io. Retrieve it from the "Organization and billing" settings of your account.

        config MENDER_CLIENT_AUTHENTICATION_POLL_INTERVAL
            int "Mender client Authentication poll interval (seconds)"
            range 0 3600
            default 600
            help
                Interval used to periodically try to authenticate to the Mender server until it succeeds.
                Setting this value to 0 permits to disable the periodic execution and relies on the application to do it.

        config MENDER_CLIENT_UPDATE_POLL_INTERVAL
            int "Mender client Update poll interval (seconds)"
            range 0 86400
            default 1800
            help
                Interval used to periodically check for new deployments on the Mender server.
                Setting this value to 0 permits to disable the periodic execution and relies on the application to do it.

        module = MENDER
        module-str = Log Level for mender
        module-help = Enables logging for mender code.
        source "subsys/logging/Kconfig.template.log_config"

    endmenu

    menu "Add-ons integration"

        menu "Configure Add-on configuration"

            config MENDER_CLIENT_ADD_ON_CONFIGURE
                bool "Mender client Configure"
                default n
                help
                    Configure add-on permits to get/set configuration key-value pairs to/from the Mender server.

            if MENDER_CLIENT_ADD_ON_CONFIGURE

                config MENDER_CLIENT_CONFIGURE_STORAGE
                    bool "Mender client Configure storage"
                    default y
                    help
                        Activate this option to save the configuration from the Mender server in the storage area of the device.

                config MENDER_CLIENT_CONFIGURE_REFRESH_INTERVAL
                    int "Mender client Configure refresh interval (seconds)"
                    range 0 86400
                    default 28800
                    help
                        Interval used to periodically refresh configuration to/from the Mender server.
                        Setting this value to 0 permits to disable the periodic execution and relies on the application to do it.

            endif

        endmenu

        menu "Inventory Add-on configuration"

            config MENDER_CLIENT_ADD_ON_INVENTORY
                bool "Mender client Inventory"
                default y
                help
                    Inventory add-on permits to send inventory key-value pairs to the Mender server.
                    It is particularly used to send artifact name and device type, and it permits to see the last check-in time of the device.

            if MENDER_CLIENT_ADD_ON_INVENTORY

                config MENDER_CLIENT_INVENTORY_REFRESH_INTERVAL
                    int "Mender client Inventory refresh interval (seconds)"
                    range 0 86400
                    default 28800
                    help
                        Interval used to periodically send inventory to the Mender server.
                        Setting this value to 0 permits to disable the periodic execution and relies on the application to do it.

            endif

        endmenu

        menu "Troubleshoot Add-on configuration"

            config MENDER_CLIENT_ADD_ON_TROUBLESHOOT
                bool "Mender client Troubleshoot (EXPERIMENTAL)"
                default n
                help
                    Troubleshoot add-on permits to perform debugging on the target from the Mender server.
                    It is particularly used to connect to the remote terminal of the device.

            if MENDER_CLIENT_ADD_ON_TROUBLESHOOT

                config MENDER_CLIENT_TROUBLESHOOT_HEALTHCHECK_INTERVAL
                    int "Mender client Troubleshoot healthcheck interval (seconds)"
                    range 10 60
                    default 30
                    help
                        Interval used to periodically perform healthcheck with the Mender server.

                config MENDER_CLIENT_TROUBLESHOOT_SHELL
                    bool "Mender client Troubleshoot Shell"
                    default y
                    help
                        Troubleshoot shell permits to display a remote shell interface on the Mender server.

                config MENDER_CLIENT_TROUBLESHOOT_FILE_TRANSFER
                    bool "Mender client Troubleshoot File Transfer"
                    default n
                    help
                        Troubleshoot file transfer permits to upload/download files to/from the device on the Mender server.

                config MENDER_CLIENT_TROUBLESHOOT_PORT_FORWARDING
                    bool "Mender client Troubleshoot Port Forwarding"
                    default n
                    help
                        Troubleshoot port forwarding permits to remotly connect to a local service from the Mender server.

            endif

        endmenu

    endmenu

    menu "Platform configuration (ADVANCED)"

        choice MENDER_PLATFORM_FLASH_TYPE
            prompt "Mender platform flash implementation type"
            default MENDER_PLATFORM_FLASH_TYPE_FLASH_IMG
            help
                Specify platform flash implementation type, select 'weak' to use you own implementation.

            config MENDER_PLATFORM_FLASH_TYPE_DFU_TARGET
                bool "DFU target"
                select DFU_TARGET
                select DFU_TARGET_MCUBOOT
            config MENDER_PLATFORM_FLASH_TYPE_FLASH_IMG
                bool "Flash IMG"
            config MENDER_PLATFORM_FLASH_TYPE_WEAK
                bool "weak"
        endchoice

        config MENDER_PLATFORM_FLASH_TYPE
            string
            default "zephyr/dfu_target" if MENDER_PLATFORM_FLASH_TYPE_DFU_TARGET
            default "zephyr/flash_img" if MENDER_PLATFORM_FLASH_TYPE_FLASH_IMG
            default "generic/weak" if MENDER_PLATFORM_FLASH_TYPE_WEAK

        choice MENDER_PLATFORM_LOG_TYPE
            prompt "Mender platform log implementation type"
            default MENDER_PLATFORM_LOG_TYPE_DEFAULT
            help
                Specify platform log implementation type, select 'weak' to use you own implementation.

            config MENDER_PLATFORM_LOG_TYPE_DEFAULT
                bool "default"
            config MENDER_PLATFORM_LOG_TYPE_WEAK
                bool "weak"
        endchoice

        config MENDER_PLATFORM_LOG_TYPE
            string
            default "zephyr" if MENDER_PLATFORM_LOG_TYPE_DEFAULT
            default "generic/weak" if MENDER_PLATFORM_LOG_TYPE_WEAK

        choice MENDER_PLATFORM_NET_TYPE
            prompt "Mender platform network implementation type"
            default MENDER_PLATFORM_NET_TYPE_DEFAULT
            help
                Specify platform network implementation type, select 'weak' to use you own implementation.

            config MENDER_PLATFORM_NET_TYPE_DEFAULT
                bool "default"
            config MENDER_PLATFORM_NET_TYPE_WEAK
                bool "weak"
        endchoice

        config MENDER_PLATFORM_NET_TYPE
            string
            default "zephyr" if MENDER_PLATFORM_NET_TYPE_DEFAULT
            default "generic/weak" if MENDER_PLATFORM_NET_TYPE_WEAK

        choice MENDER_PLATFORM_SCHEDULER_TYPE
            prompt "Mender platform scheduler implementation type"
            default MENDER_PLATFORM_SCHEDULER_TYPE_DEFAULT
            help
                Specify platform scheduler implementation type, select 'weak' to use you own implementation.

            config MENDER_PLATFORM_SCHEDULER_TYPE_DEFAULT
                bool "default"
            config MENDER_PLATFORM_SCHEDULER_TYPE_WEAK
                bool "weak"
        endchoice

        config MENDER_PLATFORM_SCHEDULER_TYPE
            string
            default "zephyr" if MENDER_PLATFORM_SCHEDULER_TYPE_DEFAULT
            default "generic/weak" if MENDER_PLATFORM_SCHEDULER_TYPE_WEAK

        choice MENDER_PLATFORM_STORAGE_TYPE
            prompt "Mender platform storage implementation type"
            default MENDER_PLATFORM_STORAGE_TYPE_NVS
            help
                Specify platform storage implementation type, select 'weak' to use you own implementation.

            config MENDER_PLATFORM_STORAGE_TYPE_NVS
                bool "nvs"
                select NVS
            config MENDER_PLATFORM_STORAGE_TYPE_PSA_ITS
                bool "PSA Internal Trusted Storage"
                depends on BUILD_WITH_TFM
            config MENDER_PLATFORM_STORAGE_TYPE_PSA_PS
                bool "PSA Protected Storage"
                depends on BUILD_WITH_TFM
            config MENDER_PLATFORM_STORAGE_TYPE_WEAK
                bool "weak"
        endchoice

        config MENDER_PLATFORM_STORAGE_TYPE
            string
            default "zephyr/nvs" if MENDER_PLATFORM_STORAGE_TYPE_NVS
            default "generic/psa_its" if MENDER_PLATFORM_STORAGE_TYPE_PSA_ITS
            default "generic/psa_ps" if MENDER_PLATFORM_STORAGE_TYPE_PSA_PS
            default "generic/weak" if MENDER_PLATFORM_STORAGE_TYPE_WEAK

        choice MENDER_PLATFORM_TLS_TYPE
            prompt "Mender platform TLS implementation type"
            default MENDER_PLATFORM_TLS_TYPE_MBEDTLS
            help
                Specify platform TLS implementation type, select 'weak' to use you own implementation.

            config MENDER_PLATFORM_TLS_TYPE_MBEDTLS
                bool "mbedtls"
                select MBEDTLS
            config MENDER_PLATFORM_TLS_TYPE_CRYPTOAUTHLIB
                bool "cryptoauthlib"
            config MENDER_PLATFORM_TLS_TYPE_PSA_CRYPTO
                bool "PSA Crypto"
                depends on BUILD_WITH_TFM
            config MENDER_PLATFORM_TLS_TYPE_WEAK
                bool "weak"
        endchoice

        config MENDER_PLATFORM_TLS_TYPE
            string
            default "generic/mbedtls" if MENDER_PLATFORM_TLS_TYPE_MBEDTLS
            default "generic/cryptoauthlib" if MENDER_PLATFORM_TLS_TYPE_CRYPTOAUTHLIB
            default "generic/psa_crypto" if MENDER_PLATFORM_TLS_TYPE_PSA_CRYPTO
            default "generic/weak" if MENDER_PLATFORM_TLS_TYPE_WEAK

    endmenu

    if MENDER_PLATFORM_FLASH_TYPE_DFU_TARGET

        menu "Flash options (ADVANCED)"

            config MENDER_FLASH_MCUBOOT_BUFFER_SIZE
                int "DFU target MCUboot buffer size"
                default 512
                help
                    DFU target MCUboot buffer size, see 'dfu_target_mcuboot_set_buf'.

            config MENDER_FLASH_MCUBOOT_IMAGE_NUMBER
                int "DFU target MCUboot image number"
                default 0
                help
                    DFU target MCUboot image number, see 'dfu_target_init'.

        endmenu

    endif

    if MENDER_PLATFORM_NET_TYPE_DEFAULT

        menu "Network options (ADVANCED)"

            config MENDER_NET_CA_CERTIFICATE_TAG_PRIMARY
                int "Primary CA certificate tag"
                default 1
                help
                    A security tag that ROOT CA server credential will be referenced with, see tls_credential_add.

            config MENDER_NET_CA_CERTIFICATE_TAG_SECONDARY
                int "Secondary CA certificate tag"
                default 0
                help
                    A secondary security tag that ROOT CA server credential will be referenced with, see tls_credential_add.
                    Setting this value to 0 permits to disable the secondary CA certificate tag.

            config MENDER_NET_TLS_PEER_VERIFY
                int "TLS_PEER_VERIFY option"
                range 0 2
                default 2
                help
                    Peer verification level for TLS connection.

            if MENDER_CLIENT_ADD_ON_TROUBLESHOOT

                config MENDER_WEBSOCKET_THREAD_STACK_SIZE
                    int "Mender WebSocket client Thread Stack Size"
                    range 0 65536
                    default 4096
                    help
                        Mender WebSocket client thread stack size, customize only if you have a deep understanding of the impacts! Default value is suitable for most applications.

                config MENDER_WEBSOCKET_THREAD_PRIORITY
                    int "Mender WebSocket client Thread Priority"
                    range 0 128
                    default 5
                    help
                        Mender WebSocket client thread priority, customize only if you have a deep understanding of the impacts! Default value is suitable for most applications.

                config MENDER_WEBSOCKET_CONNECT_TIMEOUT
                    int "Mender WebSocket client connect timeout (milliseconds)"
                    range 0 60000
                    default 3000
                    help
                        Mender WebSocket client connect timeout. Default value is suitable for most applications.

                config MENDER_WEBSOCKET_REQUEST_TIMEOUT
                    int "Mender WebSocket client request timeout (milliseconds)"
                    range 0 60000
                    default 3000
                    help
                        Mender WebSocket client request timeout. Default value is suitable for most applications.

            endif

        endmenu

    endif

    if MENDER_PLATFORM_SCHEDULER_TYPE_DEFAULT

        menu "Scheduler options (ADVANCED)"

            config MENDER_SCHEDULER_WORK_QUEUE_STACK_SIZE
                int "Mender Scheduler Work Queue Stack Size"
                range 0 65536
                default 12288
                help
                    Mender scheduler work queue stack size, customize only if you have a deep understanding of the impacts! Default value is suitable for most applications.

            config MENDER_SCHEDULER_WORK_QUEUE_PRIORITY
                int "Mender Scheduler Work Queue Priority"
                range 0 128
                default 5
                help
                    Mender scheduler work queue priority, customize only if you have a deep understanding of the impacts! Default value is suitable for most applications.

        endmenu

    endif

    if MENDER_PLATFORM_TLS_TYPE_MBEDTLS

        menu "TLS options (ADVANCED)"

            choice MENDER_PLATFORM_TLS_KEY_TYPE
                prompt "Mender platform TLS key type"
                default MENDER_PLATFORM_TLS_KEY_TYPE_ECDSA
                help
                    Specify platform TLS key type.

                config MENDER_PLATFORM_TLS_KEY_TYPE_ECDSA
                    bool "ECDSA-P256"
                config MENDER_PLATFORM_TLS_KEY_TYPE_RSA
                    bool "RSA-3072"
            endchoice

        endmenu

    endif

    if MENDER_PLATFORM_TLS_TYPE_CRYPTOAUTHLIB

        menu "TLS options (ADVANCED)"

            config MENDER_TLS_PRIVATE_KEY_ID
                int "Mender TLS cryptoauthlib private key ID"
                default 0
                help
                    Cryptoauthlib private key ID.

        endmenu

    endif

    if MENDER_PLATFORM_TLS_TYPE_PSA_CRYPTO

        menu "TLS options (ADVANCED)"

            config MENDER_TLS_PSA_CRYPTO_SIGNATURE_KEY_ID
                int "Mender TLS PSA Crypto signature key ID"
                default 1
                help
                    PSA Crypto signature key ID.

        endmenu

    endif

    if MENDER_CLIENT_ADD_ON_TROUBLESHOOT

        menu "Shell options (ADVANCED)"

            config MENDER_SHELL_PROMPT
                string "Mender Shell prompt"
                default "~$ "
                help
                    Mender Shell prompt to be dislayed on the Mender server Troubleshoot add-on interface.

            config MENDER_SHELL_RX_RING_BUFFER_SIZE
                int "Mender Shell RX ring buffer size (bytes)"
                range 0 512
                default 64
                help
                    Mender Shell RX ring buffer size. Default value is suitable for most applications.

            config MENDER_SHELL_TX_RING_BUFFER_SIZE
                int "Mender Shell TX ring buffer size (bytes)"
                range 0 2048
                default 512
                help
                    Mender Shell TX ring buffer size. Default value is suitable for most applications.

            config MENDER_SHELL_TX_WORK_QUEUE_STACK_SIZE
                int "Mender Shell TX Work Queue Stack Size"
                range 0 65536
                default 2048
                help
                    Mender Shell TX work queue stack size, customize only if you have a deep understanding of the impacts! Default value is suitable for most applications.

            config MENDER_SHELL_TX_WORK_QUEUE_PRIORITY
                int "Mender Shell TX Work Queue Priority"
                range 0 128
                default 5
                help
                    Mender Shell TX work queue priority, customize only if you have a deep understanding of the impacts! Default value is suitable for most applications.

            config MENDER_SHELL_TX_WORK_DELAY
                int "Mender Shell TX Work Delay (milliseconds)"
                range 0 1000
                default 100
                help
                    Mender Shell TX work delay, used to flush data of the TX work queue. Default value is suitable for most applications.

            config MENDER_SHELL_LOG_BACKEND_LEVEL
                int "Mender Shell Log Backend Level"
                range 0 4
                default 0
                help
                    Mender Shell log backend level. Default value is no log (log backend disabled).

            config MENDER_SHELL_LOG_BACKEND_MESSAGE_QUEUE_SIZE
                int "Mender Shell Log Backend Message Queue Size (bytes)"
                range 0 2048
                default 512
                help
                    Mender Shell log backend message queue size. Default value is suitable for most applications.

            config MENDER_SHELL_LOG_BACKEND_MESSAGE_QUEUE_TIMEOUT
                int "Mender Shell Log Backend Message Queue Timeout (milliseconds)"
                range 0 1000
                default 100
                help
                    Mender Shell log backend message queue timeout. Default value is suitable for most applications.

        endmenu

    endif

    if MENDER_PLATFORM_STORAGE_TYPE_NVS

        menu "Storage options"

            config MENDER_STORAGE_NVS_PRIVATE_KEY
                int "NVS Storage private key ID"
                default 1
                help
                    NVS Storage private key ID.

            config MENDER_STORAGE_NVS_PUBLIC_KEY
                int "NVS Storage public key ID"
                default 2
                help
                    NVS Storage public key ID.

            config MENDER_STORAGE_NVS_DEPLOYMENT_DATA
                int "NVS Storage deployment data ID"
                default 3
                help
                    NVS Storage deployment data ID.

            config MENDER_STORAGE_NVS_DEVICE_CONFIG
                int "NVS Storage device configuration ID"
                default 4
                help
                    NVS Storage device configuration ID.

        endmenu

    endif

    if MENDER_PLATFORM_STORAGE_TYPE_PSA_ITS

        menu "Storage options"

            config MENDER_STORAGE_PSA_STORAGE_UID_DEPLOYMENT_DATA
                int "PSA Internal Trusted Storage deployment data UID"
                default 1
                help
                    PSA Internal Trusted Storage deployment data UID.

            config MENDER_STORAGE_PSA_STORAGE_UID_DEVICE_CONFIG
                int "PSA Internal Trusted Storage device configuration UID"
                default 2
                help
                    PSA Internal Trusted Storage device configuration UID.

        endmenu

    endif

    if MENDER_PLATFORM_STORAGE_TYPE_PSA_PS

        menu "Storage options"

            config MENDER_STORAGE_PSA_STORAGE_UID_DEPLOYMENT_DATA
                int "PSA Protected Storage deployment data UID"
                default 1
                help
                    PSA Protected Storage deployment data UID.

            config MENDER_STORAGE_PSA_STORAGE_UID_DEVICE_CONFIG
                int "PSA Protected Storage device configuration UID"
                default 2
                help
                    PSA Protected Storage device configuration UID.

        endmenu

    endif

endif
```
